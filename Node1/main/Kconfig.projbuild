## Node1/main/Kconfig.projbuild
```kconfig
menu "Node 1 Pump Configuration"

    config NODE1_RELAY_GPIO
        int "GPIO number connected to relay IN pin"
        range 0 39
        default 23
        help
            GPIO ESP32 DevKit yang terhubung ke pin IN modul relay.
            Rekomendasi: 23. Hindari strapping pins 0, 2, 5, 12, 15
            (GPIO15 = MTDO, mempengaruhi boot log ESP32 classic).

    config NODE1_RELAY_ACTIVE_LOW
        bool "Relay module is active-LOW (IN low = relay ON)"
        default y
        help
            Banyak modul relay 1-channel murah active-LOW.
            Default ini mengikuti sketch Arduino lama Node 1
            (RELAY_ACTIVE_LOW true). Jika pompa terbalik perilakunya
            (ON saat harusnya OFF), matikan opsi ini di menuconfig.

    config NODE1_RESTORE_ONOFF_AFTER_REBOOT
        bool "Restore last pump state after reboot"
        default n
        help
            Nonaktif (default, fail-safe): pompa selalu OFF setelah
            boot/power-loss/restart, state mesh & NVS disinkronkan ke OFF.
            Aktif: pompa kembali ke state OnOff terakhir yang tersimpan
            di NVS (untuk kontinuitas jadwal irigasi).

endmenu
```

## Node2/main/Kconfig.projbuild
```kconfig
menu "Node 2 Smart Irrigation"

config NODE2_SLEEP_INTERVAL_SEC
    int "Deep sleep interval (seconds)"
    range 30 86400
    default 300

config NODE2_SOIL_ADC_ENABLE
    bool "Enable soil sensor ADC reads"
    default y
    help
        Enable only after measuring the sensor AO voltage and confirming it
        does not exceed the ESP32 GPIO input limit.

config NODE2_SOIL_ADC_DRY_RAW
    int "Soil ADC raw value in dry soil"
    range 0 4095
    default 3000
    depends on NODE2_SOIL_ADC_ENABLE
    help
        Replace the default with a measured dry-soil ADC value.

config NODE2_SOIL_ADC_WET_RAW
    int "Soil ADC raw value in wet soil"
    range 0 4095
    default 1500
    depends on NODE2_SOIL_ADC_ENABLE
    help
        Replace the default with a measured wet-soil ADC value.

endmenu
```

## Node2/sdkconfig.defaults
```kconfig
CONFIG_IDF_TARGET="esp32"
CONFIG_BT_ENABLED=y
CONFIG_BT_BLUEDROID_ENABLED=y
CONFIG_BT_BLE_50_FEATURES_SUPPORTED=n
CONFIG_BT_BLE_42_FEATURES_SUPPORTED=y
CONFIG_BLE_MESH=y
CONFIG_BLE_MESH_NODE=y
CONFIG_BLE_MESH_PROVISIONER=n
CONFIG_BLE_MESH_PB_ADV=y
CONFIG_BLE_MESH_PB_GATT=n
CONFIG_BLE_MESH_SETTINGS=y
CONFIG_BLE_MESH_RELAY=n
CONFIG_BLE_MESH_FRIEND=n
CONFIG_BLE_MESH_LOW_POWER=y
CONFIG_BLE_MESH_GENERIC_SERVER=n
CONFIG_NODE2_SOIL_ADC_ENABLE=y
CONFIG_NODE2_SOIL_ADC_DRY_RAW=3000
CONFIG_NODE2_SOIL_ADC_WET_RAW=1500
CONFIG_NODE2_SLEEP_INTERVAL_SEC=300
```

## Node3/main/Kconfig.projbuild
```kconfig
menu "Node 3 status output"

config NODE3_STATUS_LED_GPIO
    int "Status LED GPIO (-1 disables the LED)"
    range -1 48
    default -1
    help
        Set this to the GPIO connected to the board LED. The default disables
        the LED because the exact T-Display board and LED pin are not specified.

config NODE3_STATUS_LED_ACTIVE_LOW
    bool "Status LED is active-low"
    depends on NODE3_STATUS_LED_GPIO >= 0
    default n

endmenu
```

## Node4/main/Kconfig.projbuild
```kconfig
# Kconfig untuk Node 4
menu "Node 4 Wi-Fi Configuration"

    config WIFI_STA_SSID
        string "Wi-Fi SSID"
        default "MyRouter"
        help
            SSID jaringan Wi-Fi yang digunakan Node 4.

    config WIFI_STA_PASSWORD
        string "Wi-Fi Password"
        default ""
        help
            Password Wi-Fi (minimal 8 karakter untuk WPA2).

endmenu

menu "Node 4 MQTT Configuration"

    config MQTT_BROKER_URI
        string "MQTT Broker URI"
        default "mqtt://192.168.0.101:1883"
        help
            URI broker MQTT (Mosquitto di PC).
            Contoh: mqtt://192.168.0.100:1883
            Ganti sesuai IP komputer Anda di jaringan yang sama.

endmenu
```
